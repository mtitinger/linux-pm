## Documentation/devicetree/bindings/arm/cpudomains.txt
```
ARM CPU Power domains

The device tree allows describing of CPU power domains in a SoC. In ARM SoC,
CPUs may be grouped as clusters. A cluster may have CPUs, GIC, Coresight,
caches, VFP and power controller and other peripheral hardware. Generally,
when the CPUs in the cluster are idle/suspended, the shared resources may also
be suspended and resumed before any of the CPUs resume execution.

CPUs are the defined as the PM domain consumers and there is a PM domain
provider for the CPUs. Bindings for generic PM domains (genpd) is described in
[1].

The ARM CPU PM domain follows the same binding convention as any generic PM
domain. Additional binding properties are -

- compatible:
	Usage: required
	Value type: <string>
	Definition: Must also have
			"arm,pd"
		inorder to initialize the genpd provider as ARM CPU PM domain.

[1]. Documentation/devicetree/bindings/power/power_domain.txt
```

## Documentation/devicetree/bindings/power/power_domain.txt
```
* Generic PM domains

System on chip designs are often divided into multiple PM domains that can be
used for power gating of selected IP blocks for power saving by reduced leakage
current.

This device tree binding can be used to bind PM domain consumer devices with
their PM domains provided by PM domain providers. A PM domain provider can be
represented by any node in the device tree and can provide one or more PM
domains. A consumer node can refer to the provider by a phandle and a set of
phandle arguments (so called PM domain specifiers) of length specified by the
#power-domain-cells property in the PM domain provider node.

==PM domain providers==

Required properties:
 - #power-domain-cells : Number of cells in a PM domain specifier;
   Typically 0 for nodes representing a single PM domain and 1 for nodes
   providing multiple PM domains (e.g. power controllers), but can be any value
   as specified by device tree binding documentation of particular provider.

Optional properties:
 - power-domains : A phandle and PM domain specifier as defined by bindings of
                   the power controller specified by phandle.
   Some power domains might be powered from another power domain (or have
   other hardware specific dependencies). For representing such dependency
   a standard PM domain consumer binding is used. When provided, all domains
   created by the given provider should be subdomains of the domain
   specified by this binding. More details about power domain specifier are
   available in the next section.

 - power-states : a phandle of an idle-state that shall be soaked into a
		  generic domain power state.
   CPU domains: Deep c-states that match a cluster power-off can be delegated to the
   generic power domain. Device other than CPUs may have register intermediate
   power states in the same domain. The domain governor can do a good job in
   electing a power state when the last cpu is powered off as devices in the
   same genpd may register intermediate states.
   Devices : a device may register an intermediate c-state matching a memory
   retention feature for instance.

Example:

	power: power-controller@12340000 {
		compatible = "foo,power-controller";
		reg = <0x12340000 0x1000>;
		#power-domain-cells = <1>;
	};

The node above defines a power controller that is a PM domain provider and
expects one cell as its phandle argument.

Example 2:

	parent: power-controller@12340000 {
		compatible = "foo,power-controller";
		reg = <0x12340000 0x1000>;
		#power-domain-cells = <1>;
	};

	child: power-controller@12340000 {
		compatible = "foo,power-controller";
		reg = <0x12341000 0x1000>;
		power-domains = <&parent 0>;
		#power-domain-cells = <1>;
	};

Example 3:

        pm-domains {
                a57_pd: a57_pd@ {
                        /* will have a57 platform ARM_PD_METHOD_OF_DECLARE*/
                        compatible = "arm,pd","arm,cortex-a57";
                        #power-domain-cells = <0>;
                        power-states = <&CLUSTER_SLEEP_0>;
                };

                a53_pd: a53_pd@ {
                        /* will have a a53 platform ARM_PD_METHOD_OF_DECLARE*/
                        compatible = "arm,pd","arm,cortex-a53";
                        #power-domain-cells = <0>;
                        power-states = <&CLUSTER_SLEEP_0>;
                };
        };


The nodes above define two power controllers: 'parent' and 'child'.
Domains created by the 'child' power controller are subdomains of '0' power
domain provided by the 'parent' power controller.

==PM domain consumers==

Required properties:
 - power-domains : A phandle and PM domain specifier as defined by bindings of
                   the power controller specified by phandle.

Example:

	leaky-device@12350000 {
		compatible = "foo,i-leak-current";
		reg = <0x12350000 0x1000>;
		power-domains = <&power 0>;
	};

The node above defines a typical PM domain consumer device, which is located
inside a PM domain with index 0 of a power controller represented by a node
with the label "power".
```
